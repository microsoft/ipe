## security/ipe/Kconfig
```kconfig
# SPDX-License-Identifier: GPL-2.0-only
#
# Integrity Policy Enforcement (IPE) configuration
#

menuconfig SECURITY_IPE
	bool "Integrity Policy Enforcement (IPE)"
	depends on SECURITY && SECURITYFS && AUDIT && AUDITSYSCALL
	select PKCS7_MESSAGE_PARSER
	select SYSTEM_DATA_VERIFICATION
	select IPE_PROP_DM_VERITY if DM_VERITY && DM_VERITY_VERIFY_ROOTHASH_SIG
	help
	  This option enables the Integrity Policy Enforcement LSM
	  allowing users to define a policy to enforce a trust-based access
	  control. A key feature of IPE is a customizable policy to allow
	  admins to reconfigure trust requirements on the fly.

	  If unsure, answer N.

if SECURITY_IPE
menu "IPE Trust Providers"

config IPE_PROP_DM_VERITY
	bool "Enable support for dm-verity volumes"
	depends on DM_VERITY && DM_VERITY_VERIFY_ROOTHASH_SIG
	help
	  This option enables the properties 'dmverity_signature' and
	  'dmverity_roothash' in IPE policy. These properties evaluates
	  to TRUE when a file is evaluated against a dm-verity volume
	  that was mounted with a signed root-hash or the volume's
	  root hash matches the supplied value in the policy.

	  If unsure, answer Y.

config IPE_PROP_FS_VERITY
	bool "Enable property for fs-verity files"
	depends on FS_VERITY && FS_VERITY_BUILTIN_SIGNATURES
	help
	  This option enables the usage of properties "fsverity_signature"
	  and "fsverity_digest". These properties evaluates to TRUE when
	  a file is fsverity enabled and with a signed digest or its
	  diegst matches the supplied value in the policy.

	  if unsure, answer Y.

endmenu

endif
```
